## 03_ExampleAppZephyr/example-application/boards/sii/controller_l432kc/Kconfig.controller_l432kc
```kconfig
# Copyright (c) 2021 Nordic Semiconductor ASA
# SPDX-License-Identifier: Apache-2.0

config BOARD_CONTROLLER_L432KC
	select SOC_STM32L432XX
```

## 03_ExampleAppZephyr/example-application/boards/sii/controller_l432kc/board.yml
```yaml
# SPDX-License-Identifier: Apache-2.0

board:
  name: controller_l432kc
  vendor: ingeekto
  socs:
    - name: stm32l432xx
```

## 03_ExampleAppZephyr/example-application/tests/lib/custom/testcase.yaml
```yaml
common:
  tags: extensibility
  integration_platforms:
    - controller_l432kc
    - custom_plank
    - qemu_cortex_m0
tests:
  lib.custom: {}
  lib.custom.non_default:
    extra_args: CONFIG_CUSTOM_GET_VALUE_DEFAULT=6
```
