## CMakeLists.txt
```
#-------------------------------------------------------------------------------
# Zephyr Example Application
#
# Copyright (c) 2021 Nordic Semiconductor ASA
# SPDX-License-Identifier: Apache-2.0

cmake_minimum_required(VERSION 3.13.1)
find_package(Zephyr REQUIRED HINTS $ENV{ZEPHYR_BASE})

project(app LANGUAGES C)

target_sources(app PRIVATE src/main.c ./../modules/MuxDriver.c ./../modules/UtilDriver.c ./../modules/LockerStatusReader.c ./../modules/LockerDriver.c)
```

## sample.yaml
```
# This file is provided so that the application can be compiled using Twister,
# the Zephyr testing tool. In this file, multiple combinations can be specified,
# so that you can easily test all of them locally or in CI.
sample:
  description: Example application
  name: example-application 
tests:
  app.debug:
    build_only: true
    integration_platforms:
      - controller_l432kc
    extra_overlay_confs:
      - debug.conf
  app.robot:
    harness: robot
    harness_config:
      robot_testsuite: app.robot
    extra_args: DEF_RENODE_BUILD=1
  app.robot_hw:
    harness: robot
    harness_config:
      robot_testsuite: app_hw.robot
```

## prj.conf
```kconfig
# Copyright (c) 2021 Nordic Semiconductor ASA
# SPDX-License-Identifier: Apache-2.0
#
# This file contains selected Kconfig options for the application.

CONFIG_SENSOR=y
CONFIG_BLINK=y

CONFIG_GPIO=y
CONFIG_SERIAL=y
CONFIG_I2C=y
CONFIG_I2C_SHELL=y
CONFIG_SHELL=y
CONFIG_NEWLIB_LIBC=y

CONFIG_SERIAL=y
CONFIG_UART_INTERRUPT_DRIVEN=y
CONFIG_UART_LINE_CTRL=n

CONFIG_MODBUS=y
CONFIG_MODBUS_ROLE_SERVER=y
CONFIG_LOG=y

CONFIG_APP_LOG_LEVEL_DBG=y
CONFIG_ZTEST=y
```

## debug.conf
```kconfig
# Copyright (c) 2021 Nordic Semiconductor ASA
# SPDX-License-Identifier: Apache-2.0
#
# This is a Kconfig fragment which can be used to enable debug-related options
# in the application. See the README for more details.

# compiler
CONFIG_DEBUG_OPTIMIZATIONS=y

# logging
CONFIG_LOG=y
CONFIG_APP_LOG_LEVEL_DBG=y
CONFIG_ZTEST=y
```

## boards/controller_l432kc.overlay
```dts
/*
 * Copyright (c) 2021 Nordic Semiconductor ASA
 * SPDX-License-Identifier: Apache-2.0
 */

/* This devicetree overlay file will be automatically picked by the Zephyr
 * build system when building the sample for the nucleo_f302r8 board. It shows
 * how the example-application can be built on sample boards already provided
 * by Zephyr.
 */

/ {
	example_sensor: example-sensor {
		compatible = "zephyr,example-sensor";
		input-gpios = <&gpioa 12 (GPIO_PULL_UP | GPIO_ACTIVE_LOW)>;
	};

	blink_led: blink-led {
		compatible = "blink-gpio-led";
		led-gpios = <&gpiob 3 GPIO_ACTIVE_HIGH>;
		blink-period-ms = <50>;
	};
};

&gpioc {
	status = "okay";
};
```

## src/main.c
```c
/*
 * Copyright (c) 2021 Nordic Semiconductor ASA
 * SPDX-License-Identifier: Apache-2.0
 */

#include <zephyr/kernel.h>
#include <zephyr/drivers/sensor.h>
#include <zephyr/logging/log.h>

#include <app/drivers/blink.h>

#include <app_version.h>
#include <zephyr/ztest.h>

#include "MuxDriver.h"
#include "UtilDriver.h"
#include "LockerDriver.h"
#include "LockerStatusReader.h"

LOG_MODULE_REGISTER(main, CONFIG_APP_LOG_LEVEL);

bool testLockersOneToFive(void);

#define BLINK_PERIOD_MS_STEP 100U
#define BLINK_PERIOD_MS_MAX  1000U

ZTEST(app_integr, test_1)
{
	UtilDriver_Init();
	MuxDriver_Init();

	UtilDriver_PWR(true);

	LockerStatusReader_Init();
	LockerDriver_Init();

	LOG_INF("Testing ...");

	// Sleep for 2s and wait for initialization of main loops of LockerDriver and LockerStatusReader
	k_sleep(K_MSEC(2000));

	// Integration test for functionality of lockers 1-5
	bool res = testLockersOneToFive();

	zassert_equal(true, res, "Failed test");
}

ZTEST_SUITE(app_integr, NULL, NULL, NULL, NULL, NULL);

bool testLockersOneToFive(void) {
	int res = 0;
	bool test_result = true;

	for (int i = 1 ; i <=5 ; i++) {
		LOG_INF("Testing locker %d", i);

		res = LockerStatusReader_GetLockerStatus(i);
		zassert_equal(true, res, "[1.1.%d] Failed initial reading of locker status.");

		res = LockerDriver_OpenLocker(i);
		zassert_equal(0, res, "[1.2.%d] Failed opening locker.");

		k_sleep(K_MSEC(500));

		res = LockerStatusReader_GetLockerStatus(i);
		zassert_equal(false, res, "[1.3.%d] Failed reading of locker status after activating output.");

		// Test harness constructed this way, that output should be deactivated after 2s.
		k_sleep(K_MSEC(2000));

		res = LockerStatusReader_GetLockerStatus(i);
		zassert_equal(true, res, "[1.4.%d] Failed reading of locker status after deactivating output.");
	}

	LOG_INF("Hello World");

	return test_result;

}
```

## src/LockerDriver.h
```c
/**
 * @file LockerDriver.h
 * @author Przemysław Gąsior (pgasior@sii.pl)
 * @brief Module controlling outputs for the lockers
 * @details Requirements:
 * 
 * 
 * 1.0) All mux pins should be set correctly during initialization of the module
 * 
 * 
 * 1.1) Module should not be initialized multiple times
 * 
 * 1.2) Only one locker should be opened at once
 * 
 * 1.3) There are 24 lockers on the PCB
 * 
 * 1.4) Locker should be opened for maximum of 2 seconds with accuracy +-0.5s to
 * protect electric lock
 * 
 * 1.5) There should be a command (API) to open all locker
 * one by one in a sequence
 * 
 * 1.6) There should be a command (API) to interrupt
 * any active opening sequence (single or open all) and disable output
 * 
 * 1.7)(extra) Locker output should be deactivated when locker open event is
 * detected
 *
 * @version 0.1
 * @date 2024-10-15
 *
 * @copyright Copyright (c) 2024 Przemysław Gąsior
 * @license The MIT License (MIT)
 */

#pragma once

#include <stdbool.h>
#include <stdint.h>

/** Number of lockers to be handled by the module */
#define NO_OF_LOCKERS 24

/** Max control time of the locker in [ms] */
#define MAX_CONTROL_TIME_MS 2000

#define LCKR_DRIVER_PERIOD 200

/**
 * @brief   Initialize LockerDriver module
 *
 * @retval  0 on success, error code otherwise
 */
uint8_t LockerDriver_Init(void);

/**
 * @brief Main loop to control working of LockerDriver
 *
 */
void LockerDriver_Loop(void);

/**
 * @brief Non-blocking API for opening specified locker
 *
 * @param LockerNum Number of the locker to be opened
 * @return uint8_t Success (0) or error number
 */
uint8_t LockerDriver_OpenLocker(uint8_t LockerNum);

/**
 * @brief Blocking API for opening specified locker
 *
 * @param LockerNum Number of the locker to be opened
 * @return uint8_t Success (0) or error number
 */
uint8_t LockerDriver_OpenLockerBlocking(uint8_t LockerNum);

/**
 * @brief Open all lockers in a sequence
 *
 * @return uint8_t Success (0) or error number
 * (1) - Invalid argument
 * (2) - Control already in progress
 */
uint8_t LockerDriver_OpenAllLockers(void);

/**
 * @brief Immidately disable all opening sequences and outputs
 *
 */
void LockerDriver_DisableAllOutputs(void);
```

## src/LockerStatusReader.h
```c
/**
 * @file LockerStatusReader.h
 * @author Przemysław Gąsior (pgasior@sii.pl)
 * @brief Module status of the lockers
 *
 * @version 0.1
 * @date 2024-10-15
 *
 * @copyright Copyright (c) 2024 Przemysław Gąsior
 * @license The MIT License (MIT)
 */

#pragma once

#include <stdbool.h>
#include <stdint.h>

/** Max control time of the locker in [ms] */
#define LCKR_STATUS_RDR_PERIOD 200

/**
 * @brief   Initialize LockerStatusReader module
 *
 * @retval  0 on success, error code otherwise
 */
uint8_t LockerStatusReader_Init(void);

/**
 * @brief Main loop to control working of LockerStatusReader
 *
 */
void LockerStatusReader_Loop(void);

/**
 * @brief Read status of the specific locker
 * 
 * @param locker Number of the locker
 * @return 1 Locker opened
 * @return 0 Locker closed
 * @return -1 Error during reading of the status
 */
int LockerStatusReader_GetLockerStatus(uint8_t locker);
```

## src/MuxDriver.c
```c
/**
 * @file MuxDriver.c
 * @author Przemysław Gąsior (pgasior@sii.pl)
 * @brief Contains simple HAL wrapper for manipulating GPIOs for muxers
 * @version 0.1
 * @date 2024-10-14
 *
 * @copyright Copyright (c) 2024 Przemysław Gąsior
 * @license The MIT License (MIT)
 *
 */

#include "MuxDriver.h"

#include <zephyr/drivers/gpio.h>
#include <zephyr/kernel.h>
#include <zephyr/logging/log.h>

#include "stdio.h"

LOG_MODULE_REGISTER(mux_drv, LOG_LEVEL_INF);

// Muxes pins
#define MUX_S0_NODE DT_ALIAS(ctrlmuxs1)
#define MUX_S1_NODE DT_ALIAS(ctrlmuxs2)
#define MUX_S2_NODE DT_ALIAS(ctrlmuxs3)
#define MUX_S3_NODE DT_ALIAS(ctrlmuxs4)
#define MUX_E1_NODE DT_ALIAS(ctrlmuxen1)
#define MUX_E2_NODE DT_ALIAS(ctrlmuxen2)
#define MUX_COM_NODE DT_ALIAS(ctrlmuxcom)

static const struct gpio_dt_spec mux_s0_pin =
    GPIO_DT_SPEC_GET(MUX_S0_NODE, gpios);
static const struct gpio_dt_spec mux_s1_pin =
    GPIO_DT_SPEC_GET(MUX_S1_NODE, gpios);
static const struct gpio_dt_spec mux_s2_pin =
    GPIO_DT_SPEC_GET(MUX_S2_NODE, gpios);
static const struct gpio_dt_spec mux_s3_pin =
    GPIO_DT_SPEC_GET(MUX_S3_NODE, gpios);
static const struct gpio_dt_spec mux_e1_pin =
    GPIO_DT_SPEC_GET(MUX_E1_NODE, gpios);
static const struct gpio_dt_spec mux_e2_pin =
    GPIO_DT_SPEC_GET(MUX_E2_NODE, gpios);
static const struct gpio_dt_spec mux_com_pin =
    GPIO_DT_SPEC_GET(MUX_COM_NODE, gpios);

int MuxDriver_Init(void) {
    int ret;
    if (!gpio_is_ready_dt(&mux_s0_pin) || !gpio_is_ready_dt(&mux_s1_pin) ||
        !gpio_is_ready_dt(&mux_s2_pin) || !gpio_is_ready_dt(&mux_s3_pin) ||
        !gpio_is_ready_dt(&mux_e1_pin) || !gpio_is_ready_dt(&mux_e2_pin) ||
        !gpio_is_ready_dt(&mux_com_pin)) {
        return 0;
    }

    ret = gpio_pin_configure_dt(&mux_s0_pin, GPIO_OUTPUT_ACTIVE);
    if (ret < 0)
        return 0;
    ret = gpio_pin_configure_dt(&mux_s1_pin, GPIO_OUTPUT_ACTIVE);
    if (ret < 0)
        return 0;
    ret = gpio_pin_configure_dt(&mux_s2_pin, GPIO_OUTPUT_ACTIVE);
    if (ret < 0)
        return 0;
    ret = gpio_pin_configure_dt(&mux_s3_pin, GPIO_OUTPUT_ACTIVE);
    if (ret < 0)
        return 0;
    ret = gpio_pin_configure_dt(&mux_e1_pin, GPIO_OUTPUT_ACTIVE);
    if (ret < 0)
        return 0;
    ret = gpio_pin_configure_dt(&mux_e2_pin, GPIO_OUTPUT_ACTIVE);
    if (ret < 0)
        return 0;
    ret = gpio_pin_configure_dt(&mux_com_pin, GPIO_OUTPUT_ACTIVE);
    if (ret < 0)
        return 0;

    LOG_INF("MuxDriver initialized");

    return 0;
}

uint8_t MuxDriver_SetGpio(MuxGpio_t GpioPin, bool enable) {
    switch (GpioPin) {
        case MuxGpio_S0:
            LOG_DBG("Enable S0, %u", enable);
            gpio_pin_set_dt(&mux_s0_pin, enable);
            break;

        case MuxGpio_S1:
            LOG_DBG("Enable S1, %u", enable);
            gpio_pin_set_dt(&mux_s1_pin, enable);
            break;

        case MuxGpio_S2:
            LOG_DBG("Enable S2, %u", enable);
            gpio_pin_set_dt(&mux_s2_pin, enable);
            break;

        case MuxGpio_S3:
            LOG_DBG("Enable S3, %u", enable);
            gpio_pin_set_dt(&mux_s3_pin, enable);
            break;

        case MuxGpio_E1:
            LOG_DBG("Enable E1, %u", enable);
            gpio_pin_set_dt(&mux_e1_pin, enable);
            break;

        case MuxGpio_E2:
            LOG_DBG("Enable E2, %u", enable);
            gpio_pin_set_dt(&mux_e2_pin, enable);
            break;

        case MuxGpio_COM:
            LOG_DBG("Enable COM, %u", enable);
            gpio_pin_set_dt(&mux_com_pin, enable);
            break;

        default:
            return 1;
    }
    return 0;
}
```

## src/MuxDriver.h
```c
/**
 * @file MuxDriver.h
 * @author Przemysław Gąsior (pgasior@sii.pl)
 * @brief Contains simple HAL wrapper for manipulating GPIOs for muxers
 * @version 0.1
 * @date 2024-10-14
 *
 * @copyright Copyright (c) 2024 Przemysław Gąsior
 * @license The MIT License (MIT)
 */

#pragma once

#include <stdbool.h>
#include <stdint.h>

typedef enum {
    MuxGpio_S0,
    MuxGpio_S1,
    MuxGpio_S2,
    MuxGpio_S3,
    MuxGpio_E1,
    MuxGpio_E2,
    MuxGpio_COM,
    MuxGpio_Count,
} MuxGpio_t;

/**
 * @brief Initialize MuxDriver module
 *
 */
int MuxDriver_Init(void);

/**
 * @brief Set specific pin using the HAL functions
 *
 * @param GpioPin Pin to set the state
 * @param enable true/false to set/reset pin
 * @return uint8_t Return 0 if success, error otherwise
 */
uint8_t MuxDriver_SetGpio(MuxGpio_t GpioPin, bool enable);
```

## src/UtilDriver.c
```c
/**
 * @file UtilDriver.c
 * @author Przemysław Gąsior (pgasior@sii.pl)
 * @brief GPIO driver for different functions
 * @version 0.1
 * @date 2024-10-15
 *
 * @copyright Copyright (c) 2024 Przemysław Gąsior
 * @license The MIT License (MIT)
 */

#include "UtilDriver.h"

#include <zephyr/drivers/gpio.h>
#include <zephyr/kernel.h>
#include <zephyr/logging/log.h>

LOG_MODULE_REGISTER(util_drv, LOG_LEVEL_INF);

/* The devicetree node identifier for the "pwrsw" alias. */
#define PWRSW_NODE DT_ALIAS(pwrsw)

static const struct gpio_dt_spec power_sw = GPIO_DT_SPEC_GET(PWRSW_NODE, gpios);

int UtilDriver_Init(void) {
    int ret;
    if (!gpio_is_ready_dt(&power_sw)) {
        return 0;
    }

    ret = gpio_pin_configure_dt(&power_sw, GPIO_OUTPUT_ACTIVE);
    if (ret < 0) {
        return 0;
    }
    LOG_INF("UtilDriver Initialized");

    UtilDriver_PWR(false);

    return 0;
}

void UtilDriver_PWR(bool enable) {
    gpio_pin_set_dt(&power_sw, enable);
}

void UtilDriver_Delay(uint32_t ms) {
    k_sleep(K_MSEC(ms));
}

uint32_t UtilDriver_GetTick(void) {
    return k_uptime_get_32();
}
```
